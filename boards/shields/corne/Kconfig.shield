## boards/shields/corne/Kconfig.shield
```kconfig
# Copyright (c) 2020 Pete Johanson
# SPDX-License-Identifier: MIT

config SHIELD_JACKCORNE_LEFT
    def_bool $(shields_list_contains,JackCorne_left)

config SHIELD_JACKCORNE_RIGHT
    def_bool $(shields_list_contains,JackCorne_right)
```
